#if DEVICE == DEVICE_TDISPLAY

#include <View.h>
#include <BoardUtils.h>

#include <TFT_eSPI.h>

#define VIEW_TDISPLAY_ICON_WIDTH 100
#define VIEW_TDISPLAY_ICON_HEIGHT 80

// -D TFT_WIDTH=135
// -D TFT_HEIGHT=240

const unsigned char PROGMEM VIEW_TDISPLAY_ICON_BMP_SPEED[] = {
    // 'icon-speed', 100x80px
    0x00, 0x00, 0x00, 0x00, 0x00, 0x00, 0x00, 0x00, 0x00, 0x00, 0x00, 0x00, 0x00, 0x00, 0x00, 0x00,
    0x00, 0x00, 0x00, 0x00, 0x00, 0x00, 0x00, 0x00, 0x00, 0x00, 0x00, 0x00, 0x00, 0x00, 0x00, 0x00,
    0x00, 0x00, 0x00, 0x00, 0x00, 0x00, 0x00, 0x00, 0x00, 0x00, 0x00, 0x00, 0x00, 0x00, 0x00, 0x00,
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    0x00, 0x00, 0x00, 0x00, 0x00, 0x00, 0x00, 0x00, 0x00, 0x00, 0x00, 0x00, 0x00, 0x00, 0x00, 0x00
};

const unsigned char PROGMEM VIEW_TDISPLAY_ICON_BMP_BATTERY[] = {
    // 'icon-battery', 100x80px
    0x00, 0x00, 0x00, 0x00, 0x00, 0x00, 0x00, 0x00, 0x00, 0x00, 0x00, 0x00, 0x00, 0x00, 0x00, 0x00,
    0x00, 0x00, 0x00, 0x00, 0x00, 0x00, 0x00, 0x00, 0x00, 0x00, 0x00, 0x00, 0x00, 0x00, 0x00, 0x00,
    0x00, 0x00, 0x00, 0x00, 0x00, 0x00, 0x00, 0x00, 0x00, 0x00, 0x00, 0x00, 0x00, 0x00, 0x00, 0x00,
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    0x00, 0x00, 0x00, 0x00, 0x00, 0x00, 0x00, 0x00, 0x00, 0x00, 0x00, 0x00, 0x00, 0x00, 0x00, 0x00
};

const unsigned char PROGMEM VIEW_TDISPLAY_ICON_BMP_WHEEL[] = {
    // 'icon-wheel', 100x80px
    0x00, 0x00, 0x00, 0x00, 0x00, 0x00, 0x00, 0x00, 0x00, 0x00, 0x00, 0x00, 0x00, 0x00, 0x00, 0x00,
    0x00, 0x00, 0x00, 0x00, 0x00, 0x00, 0x00, 0x00, 0x00, 0x00, 0x00, 0x00, 0x00, 0x00, 0x00, 0x00,
    0x00, 0x00, 0x00, 0x00, 0x00, 0x00, 0x00, 0x00, 0x00, 0x00, 0x00, 0x00, 0x01, 0xf8, 0x00, 0x00,
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    0x00, 0x00, 0x00, 0x00, 0x00, 0x00, 0x00, 0x00, 0x00, 0x00, 0x00, 0x00, 0x00, 0x00, 0x00, 0x00
};

const unsigned char PROGMEM VIEW_TDISPLAY_ICON_BMP_CONNECTING[] = {
    // 'icon-connect', 100x80px
    0x00, 0x00, 0x00, 0x00, 0x00, 0x00, 0x00, 0x00, 0x00, 0x00, 0x00, 0x00, 0x00, 0x00, 0x00, 0x00,
    0x00, 0x00, 0x00, 0x00, 0x00, 0x00, 0x00, 0x00, 0x00, 0x00, 0x00, 0x00, 0x00, 0x00, 0x00, 0x00,
    0x00, 0x00, 0x00, 0x00, 0x00, 0x00, 0x00, 0x00, 0x00, 0x00, 0x00, 0x00, 0x00, 0x00, 0x00, 0x00,
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    0x00, 0x00, 0x00, 0x00, 0x00, 0x00, 0x00, 0x00, 0x00, 0x00, 0x00, 0x00, 0x00, 0x00, 0x00, 0x00
};

void drawSpeedValue(TFT_eSPI* display, uint8_t speed) {
    char buffer[2];

    sprintf(buffer, "%02d", speed);

    display->setTextSize(7);
    display->setTextDatum(TC_DATUM);
    display->setTextColor(TFT_GREEN, TFT_BLACK);

    display->drawChar(
        buffer[0],
        (TFT_WIDTH / 2) - 22,
        VIEW_TDISPLAY_ICON_HEIGHT
    );

    display->drawChar(
        buffer[1],
        (TFT_WIDTH / 2) - 22,
        VIEW_TDISPLAY_ICON_HEIGHT + 70
    );
};

void drawBatteryValue(TFT_eSPI* display, uint8_t percentage) {
    char buffer[4];

    sprintf(buffer, "%u%%", percentage);

    // log_i("buffer : %s", buffer);

    const uint8_t w = 40;
    const uint8_t h = 120;
    const uint8_t x = (TFT_WIDTH / 2) - (w / 2);
    const uint8_t y = VIEW_TDISPLAY_ICON_HEIGHT;

    display->fillRect(
        0,
        y,
        w,
        h,
        TFT_BLACK
    );

    const uint8_t margin = 2;
    const uint8_t barWidth = w - 2 * margin;
    const uint8_t barHeight = h - 2 * margin;
    const uint8_t barFill = barHeight - (barHeight * percentage / 100.0);

    uint32_t color = TFT_GREEN;

    if (percentage < 25) {
        color = TFT_YELLOW;
    }

    if (percentage < 15) {
        color = TFT_RED;
    }

    display->drawRoundRect(x, y, w, h, 3, TFT_GOLD);

    if (percentage == 0) {
        return;
    }

    display->fillRect(
        x + margin,
        (y + margin) + barFill,
        barWidth,
        barHeight - barFill,
        color
    );

    display->setTextSize(3);
    display->setTextDatum(TC_DATUM);
    display->setTextColor(TFT_CYAN, TFT_BLACK);
    display->drawString(String(buffer), TFT_WIDTH / 2, TFT_HEIGHT - 25);
};

void drawIcon(TFT_eSPI* display, const uint8_t *bitmap) {
    display->drawBitmap(
        (TFT_WIDTH / 2) - (VIEW_TDISPLAY_ICON_WIDTH / 2),
        0,
        bitmap,
        VIEW_TDISPLAY_ICON_WIDTH,
        VIEW_TDISPLAY_ICON_HEIGHT,
        TFT_WHITE
    );
};

void drawVerticalText(TFT_eSPI* display, std::string text, int32_t x, int32_t y, int32_t spaces = 30) {
    for (size_t i = 0; i < text.length(); i++) {
        display->drawChar(text.at(i), x, y + (spaces * i));
    }
};

template <> bool ViewPageSpeed<TFT_eSPI>::draw(TFT_eSPI* display) {
    display->fillScreen(TFT_BLACK);

    drawIcon(display, VIEW_TDISPLAY_ICON_BMP_SPEED);

    drawSpeedValue(display, 0);

    return true;
};

template <> bool ViewPageSpeed<TFT_eSPI>::update(TFT_eSPI* display, Wheel::Values* values) {
    WheelValue* value = values->get(WHEEL_CHARACTERISTIC_SPEED_RPM_UUID);
    uint8_t speed = value->format(&WheelValue::FORMATTER_KILOMETERS_PER_HOUR);

    log_d("speed : %u", speed);

    drawSpeedValue(display, speed);

    return true;
};

template <> bool ViewPageBattery<TFT_eSPI>::draw(TFT_eSPI* display) {
    display->fillScreen(TFT_BLACK);

    drawIcon(display, VIEW_TDISPLAY_ICON_BMP_BATTERY);

    drawBatteryValue(display, 0);

    return true;
};

template <> bool ViewPageBattery<TFT_eSPI>::update(TFT_eSPI* display, Wheel::Values* values) {
    WheelValue* value = values->get(WHEEL_CHARACTERISTIC_BATTERY_REMAINING_UUID);
    uint8_t percentage = value->format(&WheelValue::FORMATTER_BATTERY_REMAINING);

    log_d("percentage : %u", percentage);

    drawBatteryValue(display, percentage);

    return true;
};

template <> bool ViewPageConnecting<TFT_eSPI>::draw(TFT_eSPI* display) {
    display->fillScreen(TFT_BLACK);

    drawIcon(display, VIEW_TDISPLAY_ICON_BMP_CONNECTING);

    const uint8_t dots = 4;
    const uint8_t space = 30;
    const uint8_t radius = 10;
    const uint8_t interval = 5;
    const uint16_t y = VIEW_TDISPLAY_ICON_HEIGHT - 10;
    const uint16_t x = (TFT_WIDTH - (radius / 2)) / 2;
    const uint8_t bucket = 1 + (millis() / 1000 / interval) % dots;

    display->setTextSize(2);
    display->setTextDatum(TC_DATUM);
    display->setTextColor(TFT_CYAN, TFT_BLACK);
    display->drawString("Connecting", TFT_WIDTH / 2, TFT_HEIGHT - 20);

    for (uint8_t i = 1; i <= dots; i++) {
        display->fillCircle(
            x,
            y + (space * i),
            radius,
            (bucket == i) ? TFT_RED : TFT_YELLOW
        );
    }

    return true;
};

template <> bool ViewPageHome<TFT_eSPI>::draw(TFT_eSPI* display) {
    // draw it every ~10s
    if (this->lastChange > 0 && millis() - this->lastChange < 10000) {
        return false;
    }

    display->fillScreen(TFT_BLACK);

    drawIcon(display, VIEW_TDISPLAY_ICON_BMP_WHEEL);

    display->setTextColor(TFT_CYAN, TFT_BLACK);
    display->setTextSize(3);

    drawVerticalText(
        display,
        "Tiny",
        (TFT_WIDTH / 2) - 20,
        VIEW_TDISPLAY_ICON_HEIGHT + 10
    );

    drawVerticalText(
        display,
        "Wheel",
        (TFT_WIDTH / 2) + 10,
        VIEW_TDISPLAY_ICON_HEIGHT + 10
    );

    const uint8_t voltagePerc = BoardUtils::getBatteryPercentage();
    const uint8_t voltageW = 40;
    const uint8_t voltageH = 20;

    uint32_t voltageColor = TFT_GREEN;

    const uint8_t voltageX = 5;
    const uint8_t voltageY = TFT_HEIGHT - 20;

    const uint8_t voltageMargin = 2;
    const uint8_t voltageBarWidth = voltageW - 2 * voltageMargin;
    const uint8_t voltageBarHeight = voltageH - 2 * voltageMargin;

    log_d("Board Percentage : %u", voltagePerc);

    if (voltagePerc < 30) {
        voltageColor = TFT_YELLOW;
    }

    if (voltagePerc < 15) {
        voltageColor = TFT_RED;
    }

    display->fillRect(
        0,
        voltageY,
        voltageW,
        voltageH,
        TFT_BLACK
    );

    display->drawRoundRect(
        voltageX,
        voltageY,
        voltageW,
        voltageH,
        3,
        TFT_GOLD
    );

    display->fillRect(
        voltageX + voltageMargin,
        voltageY + voltageMargin,
        voltageBarWidth * voltagePerc / 100.0,
        voltageBarHeight,
        voltageColor
    );

    return true;
};

template <> bool ViewPageSleep<TFT_eSPI>::draw(TFT_eSPI* display) {
    for (uint8_t i = 0; i < 3; i++)
    {
        uint8_t n = 100;

        display->fillScreen(TFT_BLACK);

        while (n--)
        {
            display->drawPixel(
                random(TFT_WIDTH),
                random(TFT_HEIGHT),
                random(0x10000)
            );
        }

        delay(200);
    }

    display->fillScreen(TFT_BLACK);

    return true;
};

#endif